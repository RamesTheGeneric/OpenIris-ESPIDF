## main/Kconfig.projbuild
```kconfig
menu "OpenIris basic configuration"

    orsource "$IDF_PATH/examples/common_components/env_caps/$IDF_TARGET/Kconfig.env_caps"

    config BLINK_GPIO
        int "Blink GPIO number"
        range ENV_GPIO_RANGE_MIN ENV_GPIO_OUT_RANGE_MAX
        default 8
        help
            GPIO number (IOxx) to blink on and off the LED.
            Some GPIOs are used for other purposes (flash connections, etc.) and cannot be used to blink.

    config SUPPORTS_EXTERNAL_LED_CONTROL
        bool "Tick if your board supports the control of external IR leds (Project Babble)"
        default false
        help
            GPIO number (IOxx) to the pin controlling the LEDs found on Babble boards.
        
    config LED_C_PIN
        int "Pin number of the pin controlling the external leds (Project Babble)"
        range ENV_GPIO_RANGE_MIN ENV_GPIO_OUT_RANGE_MAX
        default 1
        help
            GPIO number (IOxx) to the pin controlling the LEDs found on Babble boards.
    
    config BLINK_PERIOD
        int "Blink period in ms"
        range 10 3600000
        default 1000
        help
            Define the blinking period in milliseconds.

    config WIRED_MODE
        bool "Wired mode"
        default false

    config WIFI_CHANNEL
        int "WiFi channel to transmit/receive on."
        default 1

    config TX_MODE
        bool "Stream video using IEEE 802.11 frames to a receiver."
        depends on !CONFIG_RX_MODE
        default false

    config RX_MODE
        bool "Receive video using IEEE 802.11 frames from a transmitter."
        depends on !CONFIG_TX_MODE
        default false

    config MDNS_HOSTNAME
        string "mDNS name"
        default "openiristracker"

    config WIFI_SSID
        string "WiFi network name"
        default ""
    
    config WIFI_PASSWORD
        string "WiFi password"
        default ""

    config AP_WIFI_SSID
        string "AP WiFi network name"
        default "EyeTrackVR"
    
    config AP_WIFI_PASSWORD
        string "AP WiFi password"
        default "12345678"

    config WIFI_TX_POWER
        int "WiFi TX power (0.25 dBm units, range 8-84 = 2-20 dBm)"
        range 8 84
        default 52
        help
            WiFi transmission power in 0.25 dBm units.
            Range: 8 (2 dBm) to 84 (20 dBm).
            Common values:
              8   =  2 dBm  (minimum)
             20   =  5 dBm
             52   = 13 dBm  (default)
             80   = 20 dBm  (maximum)
            Applied at boot. Can be overridden at runtime via the API.
endmenu
```
